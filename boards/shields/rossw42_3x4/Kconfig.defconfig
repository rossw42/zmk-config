## boards/shields/rossw42_3x4/Kconfig.defconfig
```kconfig
if SHIELD_ROSSW42_3X4

config ZMK_KEYBOARD_NAME
    default "3x4 Macropad"

config I2C
    default y

config SSD1306
    default y

config ZMK_DISPLAY
    default y

if ZMK_STUDIO

config ZMK_STUDIO_TRANSPORT_BLE
    bool
    default y

config ZMK_STUDIO_TRANSPORT_USB
    bool
    default y

config ZMK_STUDIO_LOCK_ON_DISCONNECT
    bool
    default n

endif # ZMK_STUDIO

endif
```
